# file: IR_Remote_Control_NEC_Protocol.ioc
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Mcu.Family=STM32F1
Mcu.Name=STM32F103C(8-B)Tx
Mcu.Package=LQFP48
NVIC.PriorityGroup=NVIC_PRIORITYGROUP_4
PA10.GPIO_PuPd=GPIO_NOPULL
PA10.Signal=GPIO_Input
PA13.Mode=Serial_Wire
PA13.Signal=SYS_JTMS-SWDIO
PA14.Mode=Serial_Wire
PA14.Signal=SYS_JTCK-SWCLK
PD0-OSC_IN.Mode=HSE-External-Oscillator
PD0-OSC_IN.Signal=RCC_OSC_IN
PD1-OSC_OUT.Mode=HSE-External-Oscillator
PD1-OSC_OUT.Signal=RCC_OSC_OUT
ProjectManager.HeapSize=0x200
ProjectManager.StackSize=0x400
ProjectManager.TargetToolchain=STM32CubeIDE
RCC.AHBFreq_Value=72000000
RCC.APB1CLKDivider=RCC_HCLK_DIV2
RCC.APB1Freq_Value=36000000
RCC.APB1TimFreq_Value=72000000
RCC.APB2Freq_Value=72000000
RCC.APB2TimFreq_Value=72000000
RCC.HCLKFreq_Value=72000000
RCC.PLLMUL=RCC_PLL_MUL9
RCC.PLLSourceVirtual=RCC_PLLSOURCE_HSE
RCC.SYSCLKFreq_VALUE=72000000
RCC.SYSCLKSource=RCC_SYSCLKSOURCE_PLLCLK
RCC.USBFreq_Value=72000000
board=custom

// file: Core/Src/main.c
/* USER CODE BEGIN Header */
/**
  ******************************************************************************
  * @file           : main.c
  * @brief          : Main program body
  ******************************************************************************
  * @attention
  *
  * Copyright (c) 2023 STMicroelectronics.
  * All rights reserved.
  *
  * This software is licensed under terms that can be found in the LICENSE file
  * in the root directory of this software component.
  * If no LICENSE file comes with this software, it is provided AS-IS.
  *
  ******************************************************************************
  */
/* USER CODE END Header */
#include "main.h"

void SystemClock_Config(void);
static void MX_GPIO_Init(void);
/* USER CODE BEGIN PFP */
void Start_Frame_Pulses(void);
void Get_Coded_Data(void);
void Decode_Data(uint32_t data);
/* USER CODE END PFP */

/* USER CODE BEGIN 0 */
uint32_t data;
char result;
/*Function Definitions And Implementation*/
void Delay_Microseconds_DWT(uint32_t delay){
	uint32_t cycles = (HAL_RCC_GetHCLKFreq()/1000000)*delay;
	uint32_t start = DWT->CYCCNT;
	while(DWT->CYCCNT - start < cycles);
}
void Delay_Milliseconds_DWT(uint32_t delay){
	uint32_t cycles = (HAL_RCC_GetHCLKFreq()/1000)*delay;
	uint32_t start = DWT->CYCCNT;
	while(DWT->CYCCNT - start < cycles);
}
void Delay_Seconds_DWT(uint32_t delay){
	uint32_t cycles = (HAL_RCC_GetHCLKFreq()/1)*delay;
	uint32_t start = DWT->CYCCNT;
	while(DWT->CYCCNT - start < cycles);
}

/*Data Watch Point Enabling Function*/
void Enable_DWT(void){
    DWT->CTRL |= 1;
}
/* USER CODE END 0 */

int main(void)
{

  /* MCU Configuration--------------------------------------------------------*/

  /* Reset of all peripherals, Initializes the Flash interface and the Systick. */
  HAL_Init();

  /* USER CODE BEGIN Init */
  Enable_DWT();
  /* USER CODE END Init */

  /* Configure the system clock */
  SystemClock_Config();

  /* Initialize all configured peripherals */
  MX_GPIO_Init();

  /* Infinite loop */
  /* USER CODE BEGIN WHILE */
  while (1)
  {
	  Get_Coded_Data();
	  Decode_Data(data);
	  HAL_Delay(1000);
    /* USER CODE END WHILE */

  }
}

void SystemClock_Config(void)
{
  RCC_OscInitTypeDef RCC_OscInitStruct = {0};
  RCC_ClkInitTypeDef RCC_ClkInitStruct = {0};

  /** Initializes the RCC Oscillators according to the specified parameters
  * in the RCC_OscInitTypeDef structure.
  */
  RCC_OscInitStruct.OscillatorType = RCC_OSCILLATORTYPE_HSE;
  RCC_OscInitStruct.HSEState = RCC_HSE_ON;
  RCC_OscInitStruct.HSEPredivValue = RCC_HSE_PREDIV_DIV1;
  RCC_OscInitStruct.HSIState = RCC_HSI_ON;
  RCC_OscInitStruct.PLL.PLLState = RCC_PLL_ON;
  RCC_OscInitStruct.PLL.PLLSource = RCC_PLLSOURCE_HSE;
  RCC_OscInitStruct.PLL.PLLMUL = RCC_PLL_MUL9;
  if (HAL_RCC_OscConfig(&RCC_OscInitStruct) != HAL_OK)
  {
    Error_Handler();
  }

  /** Initializes the CPU, AHB and APB buses clocks
  */
  RCC_ClkInitStruct.ClockType = RCC_CLOCKTYPE_HCLK|RCC_CLOCKTYPE_SYSCLK
                              |RCC_CLOCKTYPE_PCLK1|RCC_CLOCKTYPE_PCLK2;
  RCC_ClkInitStruct.SYSCLKSource = RCC_SYSCLKSOURCE_PLLCLK;
  RCC_ClkInitStruct.AHBCLKDivider = RCC_SYSCLK_DIV1;
  RCC_ClkInitStruct.APB1CLKDivider = RCC_HCLK_DIV2;
  RCC_ClkInitStruct.APB2CLKDivider = RCC_HCLK_DIV1;

  if (HAL_RCC_ClockConfig(&RCC_ClkInitStruct, FLASH_LATENCY_2) != HAL_OK)
  {
    Error_Handler();
  }
}

static void MX_GPIO_Init(void)
{
  GPIO_InitTypeDef GPIO_InitStruct = {0};

  /* GPIO Ports Clock Enable */
  __HAL_RCC_GPIOD_CLK_ENABLE();
  __HAL_RCC_GPIOA_CLK_ENABLE();

  /*Configure GPIO pin : PA10 */
  GPIO_InitStruct.Pin = GPIO_PIN_10;
  GPIO_InitStruct.Mode = GPIO_MODE_INPUT;
  GPIO_InitStruct.Pull = GPIO_NOPULL;
  HAL_GPIO_Init(GPIOA, &GPIO_InitStruct);

}

/* USER CODE BEGIN 4 */
void Start_Frame_Pulses(void){
  while (!(HAL_GPIO_ReadPin (GPIOA, GPIO_PIN_10)));
  while (HAL_GPIO_ReadPin (GPIOA, GPIO_PIN_10));
}

void Get_Coded_Data(void){
	while ((HAL_GPIO_ReadPin (GPIOA, GPIO_PIN_10)));
	while (!HAL_GPIO_ReadPin (GPIOA, GPIO_PIN_10));
	while (HAL_GPIO_ReadPin (GPIOA, GPIO_PIN_10));
	for (int i=0; i<32; i++)
	{
	  int count=0;
	  while (!(HAL_GPIO_ReadPin (GPIOA, GPIO_PIN_10))); // wait for pin to go high.. this is 562.5us LOW

	  while ((HAL_GPIO_ReadPin (GPIOA, GPIO_PIN_10)))  // count the space length while the pin is high
	 {
	  count++;
	  Delay_Microseconds_DWT(100);
	 }

	 if (count > 12) // if the space is more than 1.2 ms
	 {
	  data |= (1UL << (31-i));   // write 1
	 }

	 else data &= ~(1UL << (31-i));  // write 0
	}
}

void Decode_Data(uint32_t data){
	switch (data)
	{
		case (0xFFA25D):
			result = '1';
			break;

		case (0xFF629D):
			result = '2';
			break;

		case (0xFFE21D):
		result = '3';
			break;

		case (0xFF22DD):
		    result = '4';
			break;

		case (0xFF02FD):
			result = '5';
			break;

		case (0xFFC23D):
			result = '6';
			break;

		case (0xFFE01F):
			result = '7';
			break;

		case (0xFFA857):
		result = '8';
			break;

		case (0xFF906F):
		result = '9';
			break;

		case (0xFFB04F):
		result = '#';
			break;

		case (0XFF6897):
		result = '*';
			break;

		case (0xFF9867):
		result = '0';
			break;

		case (0xFF38C7):
		result = 'K';
			break;

		case (0xFF18E7):
		    result = '^';
			break;

		case (0xFF10EF):
		    result = '<';
			break;

		case (0xFF5AA5):
		    result = '>';
			break;

		case (0xFF4AB5):
		    result = 'u';
			break;

		default :
			break;
	}
}
/* USER CODE END 4 */

void Error_Handler(void)
{
  __disable_irq();
  while (1)
  {
  }
}
